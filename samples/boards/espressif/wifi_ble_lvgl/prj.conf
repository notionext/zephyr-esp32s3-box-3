## CMakeLists.txt
```
# Copyright (c) 2026 NotioNext Ltd.
# SPDX-License-Identifier: Apache-2.0

cmake_minimum_required(VERSION 3.20.0)
find_package(Zephyr REQUIRED HINTS $ENV{ZEPHYR_BASE})
project(wifi_ble_lvgl)

target_sources(app PRIVATE 
    src/main.c
    src/wifi_manager.c
    src/ble_gatt.c
    src/nvs_storage.c
    src/ui_manager.c
)
```

## prj.conf
```kconfig
# WiFi BLE Provisioning with LVGL UI Configuration

# Console and logging
CONFIG_CONSOLE=y
CONFIG_UART_CONSOLE=y
CONFIG_SERIAL=y
CONFIG_LOG=y
CONFIG_LOG_DEFAULT_LEVEL=3

# Optimize logging to reduce message drops
CONFIG_LOG_BUFFER_SIZE=4096
CONFIG_LOG_PROCESS_THREAD_STACK_SIZE=2048
CONFIG_UART_INTERRUPT_DRIVEN=y

# WiFi Configuration
CONFIG_WIFI=y
CONFIG_WIFI_ESP32=y
CONFIG_NET_L2_WIFI_MGMT=y
CONFIG_WIFI_LOG_LEVEL_INF=y

# Networking
CONFIG_NETWORKING=y
CONFIG_NET_IPV4=y
CONFIG_NET_IPV6=n
CONFIG_NET_DHCPV4=y
CONFIG_NET_CONFIG_SETTINGS=y
CONFIG_NET_CONFIG_INIT_TIMEOUT=0

# BLE Configuration
CONFIG_BT=y
CONFIG_BT_PERIPHERAL=y
CONFIG_BT_DEVICE_NAME="ESP32_S3_BOX3_BLE"
CONFIG_BT_DEVICE_APPEARANCE=833
CONFIG_BT_SMP=n
CONFIG_BT_BONDABLE=n
CONFIG_BT_CONN_PARAM_UPDATE_TIMEOUT=5000

# GATT Configuration
CONFIG_BT_GATT_SERVICE_CHANGED=y
CONFIG_BT_GATT_CACHING=y
CONFIG_BT_GATT_ENFORCE_SUBSCRIPTION=n
CONFIG_BT_ATT_PREPARE_COUNT=2
CONFIG_BT_L2CAP_TX_BUF_COUNT=8
CONFIG_BT_L2CAP_TX_MTU=247
CONFIG_BT_BUF_ACL_RX_SIZE=251
CONFIG_BT_BUF_ACL_TX_SIZE=251

# NVS (Non-Volatile Storage) Configuration
CONFIG_NVS=y
CONFIG_FLASH=y
CONFIG_FLASH_MAP=y
CONFIG_FLASH_PAGE_LAYOUT=y

# JSON support for BLE data parsing
CONFIG_JSON_LIBRARY=y

# LVGL Configuration - Optimized for memory
CONFIG_DISPLAY=y
CONFIG_LVGL=y
CONFIG_LV_Z_AUTO_INIT=n
CONFIG_LV_Z_MEM_POOL_SIZE=16384
CONFIG_LV_Z_VDB_SIZE=32
CONFIG_LV_DPI_DEF=130
CONFIG_LV_Z_BITS_PER_PIXEL=16
CONFIG_LV_COLOR_DEPTH_16=y
CONFIG_LV_COLOR_16_SWAP=y

# Touch input support
CONFIG_INPUT=y
CONFIG_INPUT_GT911=y
CONFIG_INPUT_GT911_INTERRUPT=y

# LVGL Fonts - Only essential fonts
CONFIG_LV_FONT_MONTSERRAT_14=y
CONFIG_LV_FONT_MONTSERRAT_16=y

# Memory configuration - Optimized for ESP32-S3
CONFIG_HEAP_MEM_POOL_SIZE=80896
CONFIG_MAIN_STACK_SIZE=4096
CONFIG_SYSTEM_WORKQUEUE_STACK_SIZE=2048
CONFIG_BT_RX_STACK_SIZE=1536
CONFIG_NET_TX_STACK_SIZE=1536
CONFIG_NET_RX_STACK_SIZE=1536

# SPI for display
CONFIG_SPI=y

# GPIO for buttons and status
CONFIG_GPIO=y

# Enable reboot functionality
CONFIG_REBOOT=y
```

## src/nvs_storage.c
```c
/*
 * Copyright (c) 2026 NotioNext Ltd.
 *
 * SPDX-License-Identifier: Apache-2.0
 */

#include "nvs_storage.h"
#include <zephyr/logging/log.h>
#include <zephyr/storage/flash_map.h>
#include <zephyr/devicetree.h>
#include <string.h>

LOG_MODULE_REGISTER(nvs_storage, LOG_LEVEL_INF);

static struct nvs_fs fs;

int nvs_storage_init(void)
{
    int rc = 0;

    /* Use the storage partition defined in DTS */
    fs.flash_device = PARTITION_DEVICE(storage_partition);
    if (!device_is_ready(fs.flash_device)) {
        LOG_ERR("Flash device not ready");
        return -ENODEV;
    }

    fs.offset = PARTITION_OFFSET(storage_partition);
    fs.sector_size = 4096; /* Standard flash sector size */
    fs.sector_count = PARTITION_SIZE(storage_partition) / fs.sector_size;

    LOG_INF("NVS: offset=0x%lx, size=%d, sector_size=%d, sector_count=%d",
            (unsigned long)fs.offset, PARTITION_SIZE(storage_partition),
            fs.sector_size, fs.sector_count);

    rc = nvs_mount(&fs);
    if (rc) {
        LOG_ERR("Flash Init failed: %d", rc);
        return rc;
    }

    LOG_INF("NVS storage initialized successfully");
    return 0;
}

int nvs_save_wifi_credentials(const char *ssid, const char *password)
{
    int rc;

    if (!ssid || !password) {
        return -EINVAL;
    }

    if (strlen(ssid) >= MAX_SSID_LEN || strlen(password) >= MAX_PASSWORD_LEN) {
        LOG_ERR("SSID or password too long");
        return -EINVAL;
    }

    /* Save SSID */
    rc = nvs_write(&fs, WIFI_SSID_KEY, ssid, strlen(ssid) + 1);
    if (rc < 0) {
        LOG_ERR("Failed to write SSID: %d", rc);
        return rc;
    }

    /* Save password */
    rc = nvs_write(&fs, WIFI_PASSWORD_KEY, password, strlen(password) + 1);
    if (rc < 0) {
        LOG_ERR("Failed to write password: %d", rc);
        return rc;
    }

    /* Mark credentials as valid */
    uint8_t valid = 1;
    rc = nvs_write(&fs, WIFI_CREDENTIALS_VALID_KEY, &valid, sizeof(valid));
    if (rc < 0) {
        LOG_ERR("Failed to write credentials valid flag: %d", rc);
        return rc;
    }

    LOG_INF("WiFi credentials saved successfully - SSID: %s", ssid);
    return 0;
}

int nvs_read_wifi_credentials(char *ssid, char *password)
{
    int rc;

    if (!ssid || !password) {
        return -EINVAL;
    }

    /* Check if credentials are valid */
    if (!nvs_has_wifi_credentials()) {
        return -ENOENT;
    }

    /* Read SSID */
    rc = nvs_read(&fs, WIFI_SSID_KEY, ssid, MAX_SSID_LEN);
    if (rc < 0) {
        LOG_ERR("Failed to read SSID: %d", rc);
        return rc;
    }

    /* Read password */
    rc = nvs_read(&fs, WIFI_PASSWORD_KEY, password, MAX_PASSWORD_LEN);
    if (rc < 0) {
        LOG_ERR("Failed to read password: %d", rc);
        return rc;
    }

    LOG_INF("WiFi credentials read successfully - SSID: %s", ssid);
    return 0;
}

bool nvs_has_wifi_credentials(void)
{
    uint8_t valid = 0;
    int rc = nvs_read(&fs, WIFI_CREDENTIALS_VALID_KEY, &valid, sizeof(valid));

    if (rc < 0) {
        LOG_DBG("No valid credentials flag found: %d", rc);
        return false;
    }

    return (valid == 1);
}

int nvs_clear_wifi_credentials(void)
{
    int rc;

    /* Delete all WiFi credential keys */
    rc = nvs_delete(&fs, WIFI_SSID_KEY);
    if (rc < 0 && rc != -ENOENT) {
        LOG_ERR("Failed to delete SSID: %d", rc);
        return rc;
    }

    rc = nvs_delete(&fs, WIFI_PASSWORD_KEY);
    if (rc < 0 && rc != -ENOENT) {
        LOG_ERR("Failed to delete password: %d", rc);
        return rc;
    }

    rc = nvs_delete(&fs, WIFI_CREDENTIALS_VALID_KEY);
    if (rc < 0 && rc != -ENOENT) {
        LOG_ERR("Failed to delete credentials valid flag: %d", rc);
        return rc;
    }

    LOG_INF("WiFi credentials cleared successfully");
    return 0;
}
```

## src/nvs_storage.h
```c
/*
 * Copyright (c) 2026 NotioNext Ltd.
 *
 * SPDX-License-Identifier: Apache-2.0
 */

#ifndef NVS_STORAGE_H
#define NVS_STORAGE_H

#include <zephyr/kernel.h>
#include <zephyr/storage/flash_map.h>
#include <zephyr/kvss/nvs.h>

#define WIFI_SSID_KEY 1
#define WIFI_PASSWORD_KEY 2
#define WIFI_CREDENTIALS_VALID_KEY 3

#define MAX_SSID_LEN 32
#define MAX_PASSWORD_LEN 64

/**
 * @brief Initialize NVS storage
 * @return 0 on success, negative error code on failure
 */
int nvs_storage_init(void);

/**
 * @brief Save WiFi credentials to NVS
 * @param ssid WiFi SSID
 * @param password WiFi password
 * @return 0 on success, negative error code on failure
 */
int nvs_save_wifi_credentials(const char *ssid, const char *password);

/**
 * @brief Read WiFi credentials from NVS
 * @param ssid Buffer to store SSID (must be at least MAX_SSID_LEN bytes)
 * @param password Buffer to store password (must be at least MAX_PASSWORD_LEN bytes)
 * @return 0 on success, negative error code on failure
 */
int nvs_read_wifi_credentials(char *ssid, char *password);

/**
 * @brief Check if valid WiFi credentials exist in NVS
 * @return true if credentials exist, false otherwise
 */
bool nvs_has_wifi_credentials(void);

/**
 * @brief Clear WiFi credentials from NVS
 * @return 0 on success, negative error code on failure
 */
int nvs_clear_wifi_credentials(void);

#endif /* NVS_STORAGE_H */
```
